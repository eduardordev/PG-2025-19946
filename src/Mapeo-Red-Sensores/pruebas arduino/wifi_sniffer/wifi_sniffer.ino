// wifi_sniffer.ino
// Wifi Sniffer con Arduino
// Creado por Eduardo Ramirez

#include <dw3000.h>
#include <dw3000_config_options.h>
#include <dw3000_device_api.h>
#include <dw3000_mac_802_15_4.h>
#include <dw3000_port.h>
#include <dw3000_regs.h>
#include <dw3000_shared_defines.h>
#include <dw3000_shared_functions.h>
#include <dw3000_types.h>
#include <dw3000_uart.h>
#include <dw3000_vals.h>
#include <dw3000_version.h>

#include <Wire.h>
#include <U8g2lib.h>
#include <DW3000.h>

#define LED_PIN 2
#define PIN_RST 27
#define PIN_IRQ 34
#define PIN_SS 5

U8G2_SH1106_128X64_NONAME_F_SW_I2C oled(U8G2_R0, /* clock=*/9, /* data=*/8, /* reset=*/U8X8_PIN_NONE);
DW3000Class DW;

// Logo UVG (64x64 px aprox)
const unsigned char uvg_logo [] PROGMEM = {
  0xff, 0x1f, 0x00, 0x00, 0x00, 0x00, 0x00, 0x00, 0x00, 0x00, 0x00, 0x00, 0x00, 0x00, 0xf8, 0xff, 
	0xff, 0x1f, 0x00, 0x00, 0x00, 0x00, 0x00, 0x00, 0x00, 0x00, 0x00, 0x00, 0x00, 0x00, 0xf8, 0xff, 
	0xff, 0x1f, 0x00, 0x00, 0x00, 0x00, 0x00, 0x00, 0x00, 0x00, 0x00, 0x00, 0x00, 0x00, 0xf8, 0xff, 
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	0xff, 0x1f, 0x00, 0x00, 0x00, 0x00, 0x00, 0x00, 0x00, 0x00, 0x00, 0x00, 0x00, 0x00, 0xf8, 0xff
};

const unsigned char jack [] PROGMEM = {
	0xff, 0xff, 0xff, 0xff, 0xff, 0xff, 0xff, 0xff, 0xff, 0xff, 0xff, 0xff, 0xff, 0xff, 0xff, 0xff, 
	0xff, 0xff, 0xff, 0xff, 0xff, 0xff, 0xff, 0xff, 0xff, 0xff, 0xff, 0xff, 0xff, 0xff, 0xff, 0xff, 
	0xff, 0xff, 0xff, 0xff, 0xff, 0xff, 0xff, 0xff, 0xcf, 0xff, 0xff, 0xff, 0xff, 0xff, 0xff, 0xff, 
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	0xff, 0xff, 0xff, 0xff, 0xff, 0xff, 0x77, 0xf8, 0xff, 0x8c, 0xff, 0xf1, 0xff, 0xff, 0xff, 0xff
};

void showWelcomeMessage() {
  oled.clearBuffer();
  oled.drawXBMP(0, 0, 128, 64, uvg_logo);  // Mostrar logo UVG
  oled.sendBuffer();
  delay(2000);

  oled.clearBuffer();
  oled.drawXBMP(0, 0, 128, 64, jack);  // Mostrar logo Jack
  oled.sendBuffer();
  delay(2000);

  oled.clearBuffer();
  oled.setFont(u8g2_font_6x10_tr);
  oled.drawStr(0, 20, "Bienvenido al Sniffer");
  oled.drawStr(0, 35, "AR UVG TOUR");
  oled.drawStr(0, 50, "UWB Packet Listener");
  oled.sendBuffer();
  delay(2500);
}

void setup() {
  pinMode(LED_PIN, OUTPUT);
  digitalWrite(LED_PIN, LOW);

  Serial.begin(115200);
  delay(1000);

  Wire.begin(8, 9);
  oled.begin();
  oled.setFont(u8g2_font_6x10_tr);

  showWelcomeMessage();

  if (!DW.begin(PIN_SS, PIN_IRQ, PIN_RST)) {
    oled.clearBuffer();
    oled.drawStr(0, 30, "Error al iniciar wifi sniffer");
    oled.sendBuffer();
    while (1);
  }

  DW.setDeviceAddress(1);
  DW.setNetworkId(10);
  DW.setAntennaDelay(16436);
  DW.newReceive();
  DW.receivePermanently(true);  // Sniffer mode

  oled.clearBuffer();
  oled.drawStr(0, 20, "Sniffer UWB Activo");
  oled.drawStr(0, 40, "Esperando paquetes...");
  oled.sendBuffer();
}

void loop() {
  if (DW.isReceiveDone()) {
    int len = DW.getDataLength();
    byte data[len];
    DW.getData(data, len);

    digitalWrite(LED_PIN, HIGH);
    delay(50);
    digitalWrite(LED_PIN, LOW);

    Serial.print("Paquete UWB recibido: ");
    Serial.print(len);
    Serial.println(" bytes");
    Serial.print("Contenido (hex): ");
    for (int i = 0; i < len; i++) {
      Serial.print(data[i], HEX);
      Serial.print(" ");
    }
    Serial.println();

    // Mostrar primeros bytes en OLED
    oled.clearBuffer();
    oled.setFont(u8g2_font_5x7_tr);
    oled.drawStr(0, 10, "Paquete UWB capturado");
    oled.drawStr(0, 25, ("Tam: " + String(len) + " bytes").c_str());
    oled.drawStr(0, 40, "Bytes:");

    for (int i = 0; i < min(len, 8); i++) {
      char hexChar[4];
      sprintf(hexChar, "%02X", data[i]);
      oled.drawStr(5 + (i * 14), 55, hexChar);
    }

    oled.sendBuffer();

    DW.newReceive();  // Listo para el siguiente
  }
}